## port/esp32/main/Kconfig.projbuild
```kconfig
menu "Daly BMS monitor"

choice BMS_BUILD_MODE
    prompt "Build mode"
    default BMS_MODE_NORMAL
    help
      What the firmware does when it boots. The two diagnostic modes exist
      because the Daly field layouts and the CAN wiring are the two things
      that cannot be verified anywhere but on the bench.

config BMS_MODE_NORMAL
    bool "Normal - poll the packs and draw the UI"

config BMS_RAW_LOGGER
    bool "Raw CAN frame logger"
    help
      Dumps every transmitted and received CAN frame over USB serial and does
      not initialise the display.

      Use this on first contact with real hardware: Daly's own protocol
      document and the firmware in service disagree in places (see
      docs/hardware/daly-can-protocol.md), so the field layouts must be checked
      against an actual BMS, cross-referenced with Daly's own app, before the
      GUI is trusted.

config BMS_CAN_LOOP_TEST
    bool "CAN transceiver loop test"
    help
      Bit-bangs the CAN TX pin and watches the CAN RX pin, with the TWAI
      controller out of the picture entirely. That walks a level out through
      the transceiver's driver, onto the bus, back through its receiver and
      into the MCU - so a pass proves the whole board-side chain at once:
      3V3 on the transceiver, Rs grounded, CANH/CANL wired, and TX/RX the
      right way round.

      Worth having because every one of those faults looks identical through
      TWAI: the controller cannot read back its own bits, and reports a flood
      of bus errors whichever of them is to blame. This says which.

endchoice

config BMS_VICTRON
    bool "Broadcast the bank as a Victron CAN-bus BMS"
    default y
    help
      Send the three packs combined into one battery as Victron CAN-bus BMS
      frames, for the winch controller: 0x355 (SoC, SoH) and 0x356 (voltage,
      current, temperature), 11-bit identifiers, once a second while the
      display is polling the packs. Voltage and SoC are averaged, current
      summed, the temperature is the warmest sensor. See core/virtual_bms.h.

      The frames go out on the packs' bus at its 250 kbit/s. Victron devices
      usually run at 500 kbit/s; a controller set to that will not hear them.

config BMS_INVERT_CURRENT
    bool "Daly reports discharge above the 30000 current bias"
    default n
    help
      Which way the pack current points. Daly's own protocol document does
      not say, and the Daly drivers in circulation disagree about it.

      Settle it at bring-up: put a load on a pack and watch the current on
      its detail page. It must read negative. If it reads positive, enable
      this. The overview is unaffected either way - its dial shows magnitude
      and its CHARGING badge comes from the BMS's own state - and so is the
      charging-below-freezing alarm, for the same reason.

endmenu

menu "Remote reporting"

config BMS_REMOTE
    bool "Report to the club website and sleep when idle"
    default y
    help
      Check in with the avia-bms plugin, upload a snapshot when it asks, and
      keep the CAN bus quiet (deep sleep, "Zzz" on the screen) while nobody
      needs data, so the Daly packs can reach their own sleep. See
      docs/remote-protocol.md. Off: the old behaviour, polling forever.

config BMS_SERVER_URL
    string "API base URL"
    default "https://www.avia-dpc.be/wp-json/avia-bms/v1"
    depends on BMS_REMOTE
    help
      Must be https. The exact host matters: the device follows no
      redirects. Can be changed at runtime with the console's "server".

config BMS_WIFI_SSID
    string "Default Wi-Fi network"
    default ""
    depends on BMS_REMOTE
    help
      Used only until "wifi" is set on the console. Prefer the console:
      sdkconfig is not committed, but it is still a file on a laptop.

config BMS_WIFI_PASSWORD
    string "Default Wi-Fi password"
    default ""
    depends on BMS_REMOTE

config BMS_LOCAL_TIMEOUT_S
    int "Seconds of live screen after the last button press"
    default 300
    range 10 3600
    depends on BMS_REMOTE

config BMS_LIVE_S
    int "Seconds between live reports while the screen is on (0 = off)"
    default 5
    range 0 3600
    depends on BMS_REMOTE
    help
      While the screen is live (a button press or current flowing keeps it on), the
      board posts a snapshot to the website this often. The console's
      `live <s>` overrides it, and a value set in WP admin overrides both.

config BMS_CAN_RS_GPIO
    int "GPIO wired to the transceiver's Rs pin (-1 = not wired)"
    default 18
    range -1 48
    depends on BMS_REMOTE
    help
      Driven low while awake and high in deep sleep, which
      puts the SN65HVD230 in standby: about 0.4 mA instead of up to 10. Its
      receiver still works, so traffic on the bus still wakes the board.

      18 is the onboard KEY line (P1 pin 15); with this set to 18 the KEY
      button is no longer read. Set -1 until the wire is fitted: the
      breakout's Rs-to-GND resistor lifted at its GND end and wired to
      GPIO18 (docs/bring-up-remote.md, step 0).

endmenu
```
